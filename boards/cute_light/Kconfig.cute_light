## boards/cute_light/Kconfig.cute_light
```kconfig
# Copyright (c) 2024 Andrew Featherstone
# Copyright (c) 2025 Magpie Embedded
# SPDX-License-Identifier: Apache-2.0

config BOARD_CUTE_LIGHT
	select SOC_RP2350A_HAZARD3 if BOARD_CUTE_LIGHT_RP2350A_HAZARD3
	select SOC_RP2350A_M33 if BOARD_CUTE_LIGHT_RP2350A_M33 || BOARD_CUTE_LIGHT_RP2350A_M33_W || BOARD_CUTE_LIGHT_RP2350A_M33_MCUBOOT || BOARD_CUTE_LIGHT_RP2350A_M33_W_MCUBOOT
```

## boards/cute_light/board.yml
```yaml
board:
  name: cute_light
  full_name: Raspberry Pi Pico 2
  vendor: raspberrypi
  socs:
    - name: rp2350a
      variants:
        - name: w
          cpucluster: m33
          variants:
            - name: mcuboot
              cpucluster: m33
        - name: mcuboot
          cpucluster: m33
```
